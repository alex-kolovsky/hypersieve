/dts-v1/;

/ {
    #address-cells = <2>;
    #size-cells = <2>;

    hypervisor-config {
        // All top-level MMIO windows in the system.
        // Each window encompasses a broad peripheral cluster and the space between them.
        // The greater the number of such windows, the slower the hypervisor becomes.
        // Elements 0-1: MMIO base address (0x00000000_00000000)
        // Elements 2-3: Size (0x00000000_70000000)
     	mmio-windows = <0x0 0x0 0x0 0x70000000 0xF0000000 0x0 0x0FFFFFFF 0xFFFFFFFF>;

        // Configuration for the first guest VM.
        vm0 {
            // Path of the guest binary.
            path = "target/guest-1/guest-1.bin";

            // Size of the vector registers.
            // To turn off the vector extension,
            // set the vlen-size parameter to zero.
            vlen = <128>;

            // Maximum number of total Harts a guest can use, combining both assigned and shared Harts.
            hart-capacity = <2>;

            // Assigned Hart IDs.
            // You can assign one Hart to more than one guest.
            // Such Harts will only execute guests assigned to them.
            // Comment out or delete this parameter if you don't need to assign Harts.
            assigned-harts = <0 1>;

            // Allowed memory-mapped I/O peripherals.
            // Elements 0-1: MMIO base address (e.g., UART base address)
            // Elements 2-3: Size (The exact accessible byte-span of the registers)
            // Addresses must fall within the MMIO windows.
            // The greater the number of allowed MMIO regions, the slower the hypervisor becomes.
            // If the base address and the size are not Page-Aligned, accessing them will be significantly slower.
            allowed-mmio = <0x0 0x10000000 0x0 0x1 0xFFFFFFFF 0xDEADBEEF 0x0 0x1>;

            // Virtual address of the guest entry.
            entry = <0x0>;
        };

        // Configuration for the second guest VM.
        vm1 {
            vlen = <0>;

            // Enables the floating-point extension;
            // comment out or delete this parameter to disable it.
            floating-point-extension;

            path = "target/guest-2/guest-2.bin";

            hart-capacity = <2>;
            allowed-mmio = <0x0 0x10000000 0x0 0x1>;

            entry = <0x100000>;
        };
    };
};
